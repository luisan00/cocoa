## configs/sdkconfig.defaults.ttgo_tdisplays3_procamera
```kconfig
# -- BOARD --
CONFIG_BOARD_TTGO_TDISPLAYS3_PROCAMERA=y

# -- CPU  --
CONFIG_IDF_TARGET="esp32s3"
CONFIG_ESP_DEFAULT_CPU_FREQ_MHZ_240=y

# -- wdt deactivated on dev proccess -- 
#CONFIG_ESP_TASK_WDT_TIMEOUT_S=10
#CONFIG_ESP_INT_WDT_TIMEOUT_MS=10000
CONFIG_ESP_TASK_WDT_CHECK_IDLE_TASK_CPU0=n
CONFIG_ESP_TASK_WDT_CHECK_IDLE_TASK_CPU1=n

# -- SPI RAM --
CONFIG_SPIRAM=y
CONFIG_SPIRAM_SPEED_80M=y
CONFIG_SPIRAM_MODE_OCT=y

# partition table
CONFIG_PARTITION_TABLE_CUSTOM=y
CONFIG_PARTITION_TABLE_CUSTOM_FILENAME="partition_table/partitions.csv"
CONFIG_PARTITION_TABLE_FILENAME="partition_table/partitions.csv"
CONFIG_PARTITION_TABLE_OFFSET=0x8000
CONFIG_PARTITION_TABLE_MD5=y
CONFIG_NEWLIB_NANO_FORMAT=y

# flasher
CONFIG_ESPTOOLPY_FLASH_MODE_AUTO_DETECT=n
CONFIG_ESPTOOLPY_FLASHMODE_QIO=y
CONFIG_ESPTOOLPY_FLASHSIZE_16MB=y

# -- LOGGING LEVELS --
CONFIG_LOG_DEFAULT_LEVEL_DEBUG=y
CONFIG_LOG_MAXIMUM_LEVEL_VERBOSE=y

# -- LVGL --
CONFIG_LV_MEM_CUSTOM=y
CONFIG_LV_MEMCPY_MEMSET_STD=y
CONFIG_LV_ATTRIBUTE_FAST_MEM_USE_IRAM=y
CONFIG_LV_USE_PERF_MONITOR=y
CONFIG_LV_USE_USER_DATA=y
CONFIG_LV_COLOR_16_SWAP=y
CONFIG_LV_COLOR_DEPTH_16=y

# LVGL Fonts
CONFIG_LV_FONT_MONTSERRAT_20=y

# Either set CONFIG_LV_USE_DEMO_BENCHMARK or CONFIG_LV_USE_DEMO_STRESS to y
# Commenting out both will display my example
# CONFIG_LV_USE_DEMO_BENCHMARK=y
# CONFIG_LV_USE_DEMO_STRESS=y

# -- CRYPTO --
# --- DO NOT use MBEDTLS Hardware Acceleration ---
CONFIG_MBEDTLS_HARDWARE_SHA=n

# --TEST SUITE--
CONFIG_UNITY_ENABLE_FLOAT=y
CONFIG_UNITY_ENABLE_DOUBLE=y

# **Enable color ** on unity output
CONFIG_UNITY_ENABLE_COLOR=y
CONFIG_UNITY_ENABLE_IDF_TEST_RUNNER=y
CONFIG_UNITY_ENABLE_FIXTURE=y
```

## sdkconfig.defaults
```kconfig
# -- CPU FREQ --
CONFIG_ESP_DEFAULT_CPU_FREQ_MHZ_240=y
CONFIG_ESP_DEFAULT_CPU_FREQ_MHZ=240

# -- DEFAULT LOGGING LEVEL --
CONFIG_LOG_DEFAULT_LEVEL_DEBUG=y
# CONFIG_LOG_DEFAULT_LEVEL_INFO=y

# --DO-NOT-- USE MBEDTLS HARDWARE SHA ACCELERATION
CONFIG_MBEDTLS_HARDWARE_SHA=n

# --TEST-SUITE-- Unity options
CONFIG_UNITY_ENABLE_FLOAT=y
CONFIG_UNITY_ENABLE_DOUBLE=y
# **Enable color ** on unity output
CONFIG_UNITY_ENABLE_COLOR=y
CONFIG_UNITY_ENABLE_IDF_TEST_RUNNER=y
CONFIG_UNITY_ENABLE_FIXTURE=y
```

## sdkconfig.defaults.esp32c3
```kconfig
# -- CPU  --
CONFIG_IDF_TARGET="esp32c3"

# flasher
CONFIG_ESPTOOLPY_FLASH_MODE_AUTO_DETECT=n

# -- CRYPTO --
# ** DO NOT ** use MBEDTLS Hardware Acceleration
CONFIG_MBEDTLS_HARDWARE_SHA=n

# -- TEST SUITE --
CONFIG_UNITY_ENABLE_FLOAT=y
CONFIG_UNITY_ENABLE_DOUBLE=y
# 
# ** Enable color ** on unity output
CONFIG_UNITY_ENABLE_COLOR=y
CONFIG_UNITY_ENABLE_IDF_TEST_RUNNER=y
CONFIG_UNITY_ENABLE_FIXTURE=y
```

## test/sdkconfig.defaults
```kconfig
# -- CPU FREQ --
CONFIG_ESP_DEFAULT_CPU_FREQ_MHZ_240=y
CONFIG_ESP_DEFAULT_CPU_FREQ_MHZ=240

# -- wdt deactivated on dev proccess -- 
#CONFIG_ESP_TASK_WDT_TIMEOUT_S=10
#CONFIG_ESP_INT_WDT_TIMEOUT_MS=10000
CONFIG_ESP_TASK_WDT_CHECK_IDLE_TASK_CPU0=n
CONFIG_ESP_TASK_WDT_CHECK_IDLE_TASK_CPU1=n

# partition table
CONFIG_PARTITION_TABLE_CUSTOM=y
CONFIG_PARTITION_TABLE_CUSTOM_FILENAME="partition_table/partitions.csv"
CONFIG_PARTITION_TABLE_FILENAME="partition_table/partitions.csv"
CONFIG_PARTITION_TABLE_OFFSET=0x8000
CONFIG_PARTITION_TABLE_MD5=y
CONFIG_NEWLIB_NANO_FORMAT=y

# serial flasher
CONFIG_ESPTOOLPY_FLASHSIZE_4MB=y
CONFIG_ESPTOOLPY_FLASHSIZE="4MB"

# -- DEFAULT LOGGING LEVEL --
CONFIG_LOG_DEFAULT_LEVEL_DEBUG=y
# CONFIG_LOG_DEFAULT_LEVEL_INFO=y

# -- LittleVGL --


# --DO-NOT-- USE MBEDTLS HARDWARE SHA ACCELERATION
CONFIG_MBEDTLS_HARDWARE_SHA=n

# --TEST-SUITE-- Unity options
CONFIG_UNITY_ENABLE_FLOAT=y
CONFIG_UNITY_ENABLE_DOUBLE=y
# **Enable color ** on unity output
CONFIG_UNITY_ENABLE_COLOR=y
CONFIG_UNITY_ENABLE_IDF_TEST_RUNNER=y
CONFIG_UNITY_ENABLE_FIXTURE=y
```

## test/sdkconfig.defaults.esp32c3_devkit
```kconfig
CONFIG_BOARD_ESP32C3_DEVKIT=y

# -- CPU  --
CONFIG_IDF_TARGET="esp32c3"

# -- wdt deactivated on dev proccess -- 
#CONFIG_ESP_TASK_WDT_TIMEOUT_S=10
#CONFIG_ESP_INT_WDT_TIMEOUT_MS=10000
CONFIG_ESP_TASK_WDT_CHECK_IDLE_TASK_CPU0=n

# flasher
CONFIG_ESPTOOLPY_FLASH_MODE_AUTO_DETECT=n

# -- CRYPTO --
# ** DO NOT ** use MBEDTLS Hardware Acceleration
CONFIG_MBEDTLS_HARDWARE_SHA=n

# -- TEST SUITE --
CONFIG_UNITY_ENABLE_FLOAT=y
CONFIG_UNITY_ENABLE_DOUBLE=y
# 
# ** Enable color ** on unity output
CONFIG_UNITY_ENABLE_COLOR=y
CONFIG_UNITY_ENABLE_IDF_TEST_RUNNER=y
CONFIG_UNITY_ENABLE_FIXTURE=y
```
